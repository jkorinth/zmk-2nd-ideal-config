## config/west.yml
```yaml
manifest:
  remotes:
    - name: jkorinth
      url-base: https://github.com/jkorinth
  projects:
    - name: zephyr
      remote: jkorinth
      revision: zmk
      import: west.yml
    - name: zmk
      remote: jkorinth
      revision: 2nd_ideal
      import: app/west.yml
    - name: zmk-keyboard-2nd-ideal
      remote: jkorinth
      revision: dev
    - name: zmk-2nd-ideal-status-led
      remote: jkorinth
      revision: dev
  self:
    path: config
```
